## Kconfig
```kconfig
config ZMK_AUTOCORRECT
  bool "Autocorrect"
  default n
  help
    Enable the autocorrect feature.

# Note: For long corrections or large dictionaries, you may need to increase
# CONFIG_ZMK_BEHAVIORS_QUEUE_SIZE in your .conf file.
# Recommended: CONFIG_ZMK_BEHAVIORS_QUEUE_SIZE=128 or higher.

config ZMK_AUTOCORRECT_DELAY_MS
    int "Autocorrect keypress delay (ms)"
    default 30
    range 5 100
    help
      Base delay in milliseconds between keypresses when applying corrections.
      BLE connections typically need 30-40 ms for reliable delivery.
      USB connections can use lower values.

config ZMK_AUTOCORRECT_FAST_USB_MS
    int "Autocorrect fast USB delay (ms)"
    default 15
    range 1 30
    depends on USB_DEVICE_STACK
    help
      If set lower than ZMK_AUTOCORRECT_DELAY_MS and USB is active, use this smaller delay
      for faster corrections over USB.

config ZMK_AUTOCORRECT_WORK_DELAY_MS
    int "Autocorrect work queue delay (ms)"
    default 150
    range 50 300
    help
      Delay in milliseconds between detecting a typo and starting the correction.
      This must be long enough for the last typed character's HID report to reach
      and be processed by the host before backspaces begin, especially for
      immediate corrections (no trailing delimiter). Typical guidance:
      - USB: 50-75 ms
      - Bluetooth (BLE): 100-150 ms
      If corrections are missing the last character, increase this value.
      Note: This is not the per-key delay; see ZMK_AUTOCORRECT_DELAY_MS for that.

config ZMK_AUTOCORRECT_WORK_DELAY_BLE_MS
    int "Autocorrect work queue delay (ms) for BLE"
    default 200
    range 0 300
    depends on BT
    help
      Work delay to use when a Bluetooth connection is active. BLE typically
      has higher latency than USB, so a longer delay helps ensure the last
      typed character reaches the host before correction begins. If set to 0,
      the general ZMK_AUTOCORRECT_WORK_DELAY_MS is used for all connections.

config ZMK_AUTOCORRECT_TOGGLE_FEEDBACK
    bool "Type feedback when toggling autocorrect"
    default n
    help
      When enabled, the toggle behavior will type "on" or "off" as feedback.
      This is disabled by default to avoid interfering with host state.

config ZMK_AUTOCORRECT_DIAGNOSTICS
    bool "Enable diagnostic feedback for autocorrect toggle"
    default n
    help
      When enabled, the toggle behavior supports multi-tap diagnostics:
      - Single press: types "1" (on) or "0" (off)
      - Double press: types buffer size digit
      - Triple press: types "y" (dict valid) or "n" (invalid)
      - Quadruple press: types lookup count digit
      Disabled by default to avoid unexpected typing in production.

config ZMK_AUTOCORRECT_SELFTEST
    bool "Enable dictionary self-test at boot"
    default y
    help
      When enabled, performs a basic sanity check on the dictionary at boot.
      Verifies that DICTIONARY_SIZE > 0 and the first byte is a valid node type.
      Disable this if using a custom dictionary without standard entries.
```

## dts/bindings/behaviors/zmk,behavior-autocorrect-off.yaml
```yaml
# Copyright (c) 2024 The ZMK Contributors
# SPDX-License-Identifier: MIT

description: Autocorrect disable behavior

compatible: "zmk,behavior-autocorrect-off"

include: zero_param.yaml
```

## dts/bindings/behaviors/zmk,behavior-autocorrect-on.yaml
```yaml
# Copyright (c) 2024 The ZMK Contributors
# SPDX-License-Identifier: MIT

description: Autocorrect enable behavior

compatible: "zmk,behavior-autocorrect-on"

include: zero_param.yaml
```

## dts/bindings/behaviors/zmk,behavior-autocorrect-toggle.yaml
```yaml
# Copyright (c) 2024 The ZMK Contributors
# SPDX-License-Identifier: MIT

description: Autocorrect toggle behavior

compatible: "zmk,behavior-autocorrect-toggle"

include: zero_param.yaml
```

## tests/autocorrect/testcase.yaml
```yaml
common:
  harness: ztest
  tags: autocorrect

tests:
  autocorrect.punctuation_and_bounds:
    platform_allow: native_posix native_sim
```
