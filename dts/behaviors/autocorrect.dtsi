/*
 * Copyright (c) 2024 The ZMK Contributors
 *
 * SPDX-License-Identifier: MIT
 */

/ {
    behaviors {
        ac_togg: autocorrect_toggle {
            compatible = "zmk,behavior-autocorrect-toggle";
            #binding-cells = <0>;
            display-name = "AC Toggle";
        };
    };
};

